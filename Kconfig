## Kconfig
```kconfig
mainmenu "CANopen Bootloader Configuration"

config C2000_UID_LSW_ADDR
    hex
    default 0x000900

config C2000_UID_MSW_ADDR
    hex
    default 0x000901

config BOOTLOADER_RUN_VAL
    hex
    default 0x364C71F3

config BOOTLOADER_JUMP_VAL
    hex
    default 0xD489B4BB

config APPLICATION_RUN_VAL
    hex
    default 0x248B2ADC

config BOOT_FLAG_ADDRESS
    hex
    default 0x00FFFC
    help
        Refer to linker memory definition of BOOT_FLAG

choice
    prompt "Core Oscillator"
    default CRYSTAL_30MHZ
    config CRYSTAL_20MHZ
        bool "20MHz"
    config CRYSTAL_30MHZ
        bool "30MHz"
endchoice

choice
    prompt "Core Frequency"
    default CORE_FREQ_150MHZ
    config CORE_FREQ_150MHZ
        bool "150MHz"
    config CORE_FREQ_100MHZ
        depends on !CRYSTAL_30MHZ
        bool "100MHz"
endchoice

menu "CAN Configuration"
    choice
        prompt "CAN Peripheral"
        default USE_CAN_A
        config USE_CAN_A
            bool "CAN-A"
        config USE_CAN_B
            bool "CAN-B"
    endchoice

    choice
        prompt "CAN-TX IO"
        config CAN_TX_GPIO19
            depends on USE_CAN_A
            bool "GPIO19"
        config CAN_TX_GPIO31
            depends on USE_CAN_A
            bool "GPIO31"
        config CAN_TX_GPIO16
            depends on USE_CAN_B
            bool "GPIO16"
    endchoice

    choice
        prompt "CAN-RX IO"
        config CAN_RX_GPIO18
            depends on USE_CAN_A
            bool "GPIO18"
        config CAN_RX_GPIO30
            depends on USE_CAN_A
            bool "GPIO30"
        config CAN_RX_GPIO17
            depends on USE_CAN_B
            bool "GPIO17"
    endchoice

endmenu #"CAN Configuration"

config NODE_ID
    hex "Node ID"
    range 0x01 0x7F
    default 0x01

choice
    prompt "Baud rate"
    default BITRATE_1000KBPS
    config BITRATE_1000KBPS
        bool "1000 kbps"
    config BITRATE_800KBPS
        bool "800 kbps"
    config BITRATE_500KBPS
        bool "500 kbps"
    config BITRATE_250KBPS
        bool "250 kbps"
    config BITRATE_125KBPS
        bool "125 kbps"
    config BITRATE_50KBPS
        bool "50 kbps"
    config BITRATE_20KBPS
        bool "20 kbps"
    config BITRATE_10KBPS
        bool "10 kbps"
endchoice

config BITRATE
    int
    default 1000 if BITRATE_1000KBPS
    default 800 if BITRATE_800KBPS
    default 500 if BITRATE_500KBPS
    default 250 if BITRATE_250KBPS
    default 125 if BITRATE_125KBPS
    default 50 if BITRATE_50KBPS
    default 20 if BITRATE_20KBPS
    default 10 if BITRATE_10KBPS

menuconfig HAS_EEPROM
    bool "EEPROM"
    default n
    if HAS_EEPROM
        choice
            prompt "EEPROM Size"
            config EEPROM_SIZE_32KB
                bool "32kB"
        endchoice
        config EEPROM_SIZE
            int
            default 32768 if EEPROM_SIZE_32KB
        choice
            prompt "Page Size"
            config EEPROM_PAGE_SIZE_64
                bool "64"
        endchoice
        config EEPROM_PAGE_SIZE
            int
            default 64 if EEPROM_PAGE_SIZE_64

        config EEPROM_DEV_ADDR
            hex "EEPROM I2C Address"
            default 0x50
        config I2C_FIFO_BUFFER_SIZE
            int
            default 16
            help
                This is the I2C FIFO buffer size
        config LSS_ENTRY_SIGNATURE_ADDR
            hex "LSS Entry Signature Address"
            default 0x0000
        config LSS_DATA_BLOCK_ADDR
            hex "LSS Data Block Address"
            default 0x0040
    endif
```

## configs/controlCard28335_defconfig
```kconfig
CONFIG_C2000_UID_LSW_ADDR=0x000900
CONFIG_C2000_UID_MSW_ADDR=0x000901
CONFIG_BOOTLOADER_RUN_VAL=0x364C71F3
CONFIG_BOOTLOADER_JUMP_VAL=0xD489B4BB
CONFIG_APPLICATION_RUN_VAL=0x248B2ADC
CONFIG_BOOT_FLAG_ADDRESS=0x00FFFC
# CONFIG_CRYSTAL_20MHZ is not set
CONFIG_CRYSTAL_30MHZ=y
CONFIG_CORE_FREQ_150MHZ=y

#
# CAN Configuration
#
# CONFIG_USE_CAN_A is not set
CONFIG_USE_CAN_B=y
CONFIG_CAN_TX_GPIO16=y
CONFIG_CAN_RX_GPIO17=y
# end of CAN Configuration

CONFIG_NODE_ID=0x07
CONFIG_BITRATE_1000KBPS=y
# CONFIG_BITRATE_800KBPS is not set
# CONFIG_BITRATE_500KBPS is not set
# CONFIG_BITRATE_250KBPS is not set
# CONFIG_BITRATE_125KBPS is not set
# CONFIG_BITRATE_50KBPS is not set
# CONFIG_BITRATE_20KBPS is not set
# CONFIG_BITRATE_10KBPS is not set
CONFIG_BITRATE=1000
# CONFIG_HAS_EEPROM is not set
CONFIG_CANOPEN_LED=y
CONFIG_CANOPEN_LED_RED_GPIO=31
# CONFIG_CANOPEN_LED_RED_ACTIVE_HIGH is not set
CONFIG_CANOPEN_LED_GREEN_GPIO=34
# CONFIG_CANOPEN_LED_GREEN_ACTIVE_HIGH is not set
```

## configs/customBoard_defconfig
```kconfig
CONFIG_C2000_UID_LSW_ADDR=0x000900
CONFIG_C2000_UID_MSW_ADDR=0x000901
CONFIG_BOOTLOADER_RUN_VAL=0x364C71F3
CONFIG_BOOTLOADER_JUMP_VAL=0xD489B4BB
CONFIG_APPLICATION_RUN_VAL=0x248B2ADC
CONFIG_BOOT_FLAG_ADDRESS=0x00FFFC
CONFIG_CRYSTAL_20MHZ=y
# CONFIG_CRYSTAL_30MHZ is not set
# CONFIG_CORE_FREQ_150MHZ is not set
CONFIG_CORE_FREQ_100MHZ=y

#
# CAN Configuration
#
CONFIG_USE_CAN_A=y
# CONFIG_USE_CAN_B is not set
CONFIG_CAN_TX_GPIO19=y
# CONFIG_CAN_TX_GPIO31 is not set
CONFIG_CAN_RX_GPIO18=y
# CONFIG_CAN_RX_GPIO30 is not set
# end of CAN Configuration

CONFIG_NODE_ID=0xFF
CONFIG_BITRATE_1000KBPS=y
# CONFIG_BITRATE_800KBPS is not set
# CONFIG_BITRATE_500KBPS is not set
# CONFIG_BITRATE_250KBPS is not set
# CONFIG_BITRATE_125KBPS is not set
# CONFIG_BITRATE_50KBPS is not set
# CONFIG_BITRATE_20KBPS is not set
# CONFIG_BITRATE_10KBPS is not set
CONFIG_BITRATE=1000
CONFIG_HAS_EEPROM=y
CONFIG_EEPROM_SIZE_32KB=y
CONFIG_EEPROM_SIZE=32768
CONFIG_EEPROM_PAGE_SIZE_64=y
CONFIG_EEPROM_PAGE_SIZE=64
CONFIG_EEPROM_DEV_ADDR=0x50
CONFIG_I2C_FIFO_BUFFER_SIZE=16
CONFIG_LSS_ENTRY_SIGNATURE_ADDR=0x0000
CONFIG_LSS_DATA_BLOCK_ADDR=0x0040
```

## configs/ezDSPf28335_defconfig
```kconfig
CONFIG_BOOTLOADER_RUN_VAL=0x364C71F3
CONFIG_BOOTLOADER_JUMP_VAL=0xD489B4BB
CONFIG_APPLICATION_RUN_VAL=0x248B2ADC
CONFIG_BOOT_FLAG_ADDRESS=0x00FFFC
# CONFIG_CRYSTAL_20MHZ is not set
CONFIG_CRYSTAL_30MHZ=y
CONFIG_CORE_FREQ_150MHZ=y

#
# CAN Configuration
#
CONFIG_USE_CAN_A=y
# CONFIG_USE_CAN_B is not set
# CONFIG_CAN_TX_GPIO19 is not set
CONFIG_CAN_TX_GPIO31=y
# CONFIG_CAN_RX_GPIO18 is not set
CONFIG_CAN_RX_GPIO30=y
# end of CAN Configuration

CONFIG_NODE_ID=1
```
